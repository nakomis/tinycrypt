## embedded/esp32s3/main/Kconfig.projbuild
```kconfig
menu "tinycrypt"

config TINYCRYPT_NOTIFIER
    bool "Send presence requests to the watch and take updates from Fleet (Wi-Fi + MQTT to AWS IoT Core)"
    default y
    help
        When the CTAP core asks for user presence, publish a request that IoT Core routes through
        SNS and APNs to the watch. The BOOT button keeps working whatever happens to the network.
        Needs the prov partition from infra/scripts/provision-key.sh (Wi-Fi, IoT certificate).

config TINYCRYPT_LED
    bool "Status LED (one WS2812-class RGB LED)"
    default y
    help
        Shows connection, presence, enrolment and fault states (led_status.h).

config TINYCRYPT_LED_GPIO
    int "Status LED data GPIO (17 on the tinycrypt PCB; a dev board's own LED is on 48 or 38)"
    depends on TINYCRYPT_LED
    default 17

config TINYCRYPT_LED_BRIGHTNESS
    int "Status LED brightness, percent of full (these LEDs are blinding at 100)"
    depends on TINYCRYPT_LED
    range 1 100
    default 8

config TINYCRYPT_WATCH_BLE
    bool "Accept presence from the watch over BLE (signed challenge)"
    depends on BT_NIMBLE_ENABLED
    default y
    help
        The key advertises a GATT service; during a presence wait the enrolled watch reads a
        fresh challenge and writes its Secure Enclave signature back. Hold BOOT for 5 s while
        idle to enrol a watch. The button keeps working regardless.

config TINYCRYPT_OTA_FAIL_SELFTEST
    bool "TEST ONLY: fail the post-update self-test, to check rollback"
    default n
    help
        An image built with this fails its self-test after an update, so the bootloader rolls back
        to the previous one, which reports "rolled back" to Fleet. Never publish one for real use.

config TINYCRYPT_OTA_DOWNLOAD_DEADLINE_S
    int "Longest an update's download may take (seconds)"
    default 300
    range 10 900
    help
        BLE is paused while an update downloads, so the watch can't approve a sign-in meanwhile:
        a download that takes longer than this is abandoned (CRYPT-21). A 1.2 MB image takes well
        under a minute. Lower only to test it; publish-ota.sh refuses below 120.

endmenu
```
